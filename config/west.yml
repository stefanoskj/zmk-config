## config/west.yml
```yaml
manifest:
  defaults:
    revision: v0.3
  remotes:
    - name: zmkfirmware
      url-base: https://github.com/zmkfirmware
    - name: gpeye                         #new entry
      url-base: https://github.com/GPeye
    - name: urob
      url-base: https://github.com/urob  #new entry
  projects:
    - name: zmk
      remote: zmkfirmware
      import: app/west.yml
    - name: mario-peripheral-animation   #new entry
      remote: gpeye                       #new entry
      revision: main
    - name: zmk-helpers
      remote: urob
      revision: main                        #new entry
  self:
    path: config
```
